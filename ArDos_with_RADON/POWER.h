enum {
  WAIT_WDT, //ожидание основоного таймера
  WAIT_DSP, //ожидание дисплея
  WAIT_ADC, //ожидание АЦП
  WAIT_COMP, //ожидание компаратора
  WAIT_TIM1, //ожидание таймера 1
  WAIT_TIM2, //ожидание таймера 2
  WAIT_PWR1, //режим питания 1
  WAIT_PWR2 //режим питания 2
};
uint8_t power_status = 0; //флаги режимов сна
uint8_t power_manager = 2; //переключатель режимов питания мк

//---------------------------------------Ожидание---------------------------------------------------------
void _wait_pwr(void) //ожидание
{
  SMCR = (0x01 << SE);  //устанавливаем режим сна idle

  MCUCR = (0x01 << BODS) | (0x01 << BODSE); //выкл bod
  MCUCR = (0x01 << BODS);

  asm ("sleep");  //с этого момента спим.
}
//-------------------------------------Энергосбережение---------------------------------------------------
void _save_pwr(void) //энергосбережение
{
  SMCR = (0x01 << SM2) | (0x01 << SM1) | (0x01 << SE);  //устанавливаем режим сна standby

  MCUCR = (0x01 << BODS) | (0x01 << BODSE); //выкл bod
  MCUCR = (0x01 << BODS);

  asm ("sleep");  //с этого момента спим.
}
//-------------------------------------Глубокий сон--------------------------------------------------------
void _sleep_pwr(void) //энергосбережение
{
  SMCR = (0x01 << SM1) | (0x01 << SE);  //устанавливаем режим сна powerdown

  MCUCR = (0x01 << BODS) | (0x01 << BODSE); //выкл bod
  MCUCR = (0x01 << BODS);

  asm ("sleep");  //с этого момента спим.
}
//-------------------------Режим пониженного энергопотребления----------------------------------------------------
void _low_pwr(void) //режим пониженного энергопотребления
{
  if (!power_status) _sleep_pwr(); //режим глубокого энергосбережения
  else if (!(power_status & ((0x01 << WAIT_WDT) | (0x01 << WAIT_DSP) | (0x01 << WAIT_ADC) | (0x01 << WAIT_COMP) | (0x01 << WAIT_TIM1) | (0x01 << WAIT_TIM2) | (0x01 << WAIT_PWR1)))) _save_pwr(); //режим энергосбережения
  else if (!(power_status & ((0x01 << WAIT_WDT) | (0x01 << WAIT_DSP) | (0x01 << WAIT_COMP)))) _wait_pwr(); //режим ожидания
}
