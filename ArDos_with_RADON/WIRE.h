#define WIRE_PULL 1 //подтяжка шины I2C(0 - внешняя подтяжка | 1 - внутренняя подтяжка)
#define WIRE_SPEED 1 //скорость шины I2C(0 - 100kHz | 1 - 400kHz)

//---------------------------------------Инициализация wire--------------------------------------------
void wireInit(void) //инициализация wire
{
#if WIRE_PULL
  PORTC |= 0x30; //включаем подтяжку SDA и SCL
#else
  PORTC &= 0xCF; //отключаем подтяжку SDA и SCL
#endif
  DDRC &= 0xCF; //устанавливаем SDA и SCL как входы
#if WIRE_SPEED
  TWBR = 12; //устанавливаем скорость 400kHz
#else
  TWBR = 72; //устанавливаем скорость 100kHz
#endif
  TWSR = 0; //устанавливаем пределитель 1
}
//-----------------------------------Расшифровка статуса шины------------------------------------------
boolean wireGetStatus(void) //расшифровка статуса шины
{
  switch (TWSR & 0xF8) { //прочитали статус шины
    case 0x20: //передан SLA+W - принят NACK
    case 0x30: //передан байт - принят NACK
    case 0x48: //передан SLA+R - принят NACK
      return 1; //возвращаем ошибку
  }
  return 0; //возвращаем состояние готовности
}
//-----------------------------------Ожидание готовности шины------------------------------------------
boolean wireWait(void) //ожидание готовности шины
{
  for (uint16_t i = 500; i; i--) { //ждем флага прерывания
    if (TWCR & (0x01 << TWINT)) return wireGetStatus(); //возвращаем состояние шины
  }
  return 1; //возвращаем ошибку
}
//----------------------------------------Запуск шины wire---------------------------------------------
void wireStart(void) //запуск шины wire
{
  TWCR = (0x01 << TWSTA) | (0x01 << TWEN) | (0x01 << TWINT); //отправляем команду старт и устанавливаем флаг выполнить задачу
}
//---------------------------------------Остановка шины wire-------------------------------------------
void wireEnd(void) //остановка шины wire
{
  wireWait(); //ожидание готовности шины
  TWCR = (0x01 << TWSTO) | (0x01 << TWEN) | (0x01 << TWINT); //отправляем команду стоп и устанавливаем флаг выполнить задачу
}
//---------------------------------------Отправка байта------------------------------------------------
void wireWrite(uint8_t data) //отправка байта
{
  wireWait(); //ожидание готовности шины
  TWDR = data; //записываем данные в регистр
  TWCR = (0x01 << TWEN) | (0x01 << TWINT); //запустить передачу
}
//--------------------------------------Запуск передачи------------------------------------------------
void wireBeginTransmission(uint8_t addr, uint8_t mode) //запуск передачи
{
  wireWait(); //ожидание готовности шины
  wireStart(); //запуск шины wire
  wireWrite(addr << 0x01); //отправка устройству адреса с битом write
  wireWrite(mode); //отправляем режим записи
}
//--------------------------------------Запуск передачи------------------------------------------------
boolean wireBeginTransmission(uint8_t addr, uint8_t mode, uint16_t timer) //запуск передачи
{
  wireWait(); //ожидание готовности шины
  do {
    if (!timer--) { //если таймер истек
      wireEnd(); //остановка шины wire
      return 1; //возвращаем ошибку
    }
    wireStart(); //запуск шины wire
    wireWrite(addr << 0x01); //отправка устройству адреса с битом write
    wireWrite(mode); //отправляем режим записи
  }
  while (wireWait()); //ждем ответа
  return 0; //возвращаем нормальное состояние
}
